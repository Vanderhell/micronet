## examples/esp32_sensor/main/Kconfig.projbuild
```kconfig
menu "Micronet ESP32 Demo"

config MICRONET_DEMO_NODE_SLOT
    int "Node slot"
    range 1 3
    default 1
    help
        Select which physical board this firmware image represents.

config MICRONET_DEMO_WIFI_SSID
    string "Wi-Fi SSID"
    default "YOUR_WIFI_SSID"

config MICRONET_DEMO_WIFI_PASSWORD
    string "Wi-Fi password"
    default "YOUR_WIFI_PASSWORD"

config MICRONET_DEMO_UDP_PORT
    int "UDP port"
    range 1024 65535
    default 33333

config MICRONET_DEMO_TELEMETRY_PERIOD_MS
    int "Telemetry period in milliseconds"
    range 250 60000
    default 2000

config MICRONET_DEMO_RETRY_COUNT
    int "Transport retry count"
    range 0 10
    default 2

config MICRONET_DEMO_NODE1_IP
    string "Node 1 IPv4 address"
    default "192.168.1.101"

config MICRONET_DEMO_NODE2_IP
    string "Node 2 IPv4 address"
    default "192.168.1.102"

config MICRONET_DEMO_NODE3_IP
    string "Node 3 IPv4 address"
    default "192.168.1.103"

endmenu
```

## examples/esp32_sensor/sdkconfig.defaults
```kconfig
CONFIG_ESP_WIFI_SOFTAP_SUPPORT=n
CONFIG_ESP_WIFI_STA_DISCONNECTED_PM_ENABLE=n
CONFIG_LWIP_IPV4=y
```

## examples/esp32_stun_probe/main/Kconfig.projbuild
```kconfig
menu "Micronet STUN Probe"

config MICRONET_STUN_WIFI_SSID
    string "Wi-Fi SSID"
    default "YOUR_WIFI_SSID"

config MICRONET_STUN_WIFI_PASSWORD
    string "Wi-Fi password"
    default "YOUR_WIFI_PASSWORD"

config MICRONET_STUN_HOST
    string "STUN host"
    default ""
    help
        Leave empty to disable the STUN probe by default.

config MICRONET_STUN_PORT
    int "STUN port"
    range 1 65535
    default 19302

config MICRONET_STUN_LOCAL_PORT
    int "Local UDP port"
    range 1024 65535
    default 3479

endmenu
```

## examples/esp32_stun_probe/sdkconfig.defaults
```kconfig
CONFIG_ESP_WIFI_SOFTAP_SUPPORT=n
CONFIG_ESP_WIFI_STA_DISCONNECTED_PM_ENABLE=n
CONFIG_LWIP_IPV4=y
CONFIG_MICRONET_STUN_WIFI_SSID="YOUR_WIFI_SSID"
CONFIG_MICRONET_STUN_WIFI_PASSWORD="YOUR_WIFI_PASSWORD"
CONFIG_MICRONET_STUN_HOST=""
CONFIG_MICRONET_STUN_PORT=19302
CONFIG_MICRONET_STUN_LOCAL_PORT=3479
```
